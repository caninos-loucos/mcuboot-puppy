## boot/zephyr/boards/poodle-toy-v1.conf
```kconfig
CONFIG_MAIN_STACK_SIZE=4096
CONFIG_BOOT_VALIDATE_SLOT0=n
CONFIG_I2C=n
CONFIG_PM=n
CONFIG_CONSOLE=n
CONFIG_UART_CONSOLE=n
CONFIG_MCUBOOT_SERIAL=y
CONFIG_BOOT_SERIAL_UART=y
CONFIG_BOOT_MGMT_ECHO=y
CONFIG_MCUBOOT_INDICATION_LED=y
CONFIG_BOOT_SERIAL_NO_APPLICATION=y
CONFIG_BOOT_SERIAL_ENTRANCE_GPIO=y
CONFIG_BOOT_SERIAL_WAIT_FOR_DFU=y
CONFIG_BOOT_SERIAL_WAIT_FOR_DFU_TIMEOUT=2000
```

## boot/zephyr/boards/poodleino-toy-v1.conf
```kconfig
CONFIG_MAIN_STACK_SIZE=4096
CONFIG_BOOT_VALIDATE_SLOT0=n
CONFIG_BOOT_SWAP_USING_OFFSET=n
CONFIG_I2C=n
CONFIG_PM=n
CONFIG_BOOT_IMAGE_EXECUTABLE_RAM_START=0x1c010000
CONFIG_BOOT_IMAGE_EXECUTABLE_RAM_SIZE=262144
CONFIG_CONSOLE=n
CONFIG_UART_CONSOLE=n
CONFIG_MCUBOOT_SERIAL=y
CONFIG_BOOT_SERIAL_UART=y
CONFIG_BOOT_MGMT_ECHO=y
CONFIG_MCUBOOT_INDICATION_LED=y
CONFIG_BOOT_SERIAL_NO_APPLICATION=y
CONFIG_BOOT_SERIAL_ENTRANCE_GPIO=y
#CONFIG_BOOT_SERIAL_WAIT_FOR_DFU=y
#CONFIG_BOOT_SERIAL_WAIT_FOR_DFU_TIMEOUT=2000
#CONFIG_UPDATEABLE_IMAGE_NUMBER=2
```
